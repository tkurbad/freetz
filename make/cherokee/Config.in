## make/cherokee/Config.in
```kconfig
config FREETZ_PACKAGE_CHEROKEE
	bool "Cherokee HTTP Server 0.99.48"
	default n
	help

config FREETZ_PACKAGE_CHEROKEE_FFMPEG
	bool "Enable FFMpeg support for Cherokee"
	depends on FREETZ_PACKAGE_CHEROKEE
	select FREETZ_LIB_libavcodec
	select FREETZ_LIB_libavformat
	select FREETZ_LIB_libavutil
	default n
	help
		Link Cherokee against FFMpeg libraries

config FREETZ_PACKAGE_CHEROKEE_SSL
	bool "Enable SSL support for Cherokee"
	depends on FREETZ_PACKAGE_CHEROKEE
	select FREETZ_LIB_libssl
	default n
	help
		Link Cherokee against openssl libraries

config FREETZ_PACKAGE_CHEROKEE_STATIC
	bool "Statically linked libraries"
	depends on FREETZ_PACKAGE_CHEROKEE
	default n
	help
		Statically link Cherokee's modules
```

## make/motion/Config.in
```kconfig
config FREETZ_PACKAGE_MOTION
        bool "motion 3.2.11.1 "
        default n
        help
		Motion is a program that monitors the video signal from
		one or more cameras and is able to detect if a significant
		part of the picture has changed. Or in other words, it
		can detect motion.

		The program is written in C and is made for the Linux
		operating system.

		Motion is a command line based tool. It has absolutely no
		graphical user interface. Everything is setup either via
		the command line or via a set of configuration files
		(simple ASCII files that can be edited by any ASCII editor).

		The output from motion can be:

			* jpg files
			* ppm format files
			* mpeg video sequences

config FREETZ_PACKAGE_MOTION_FFMPEG
        bool "Build with ffmpeg support"
	depends on FREETZ_PACKAGE_MOTION
	select FREETZ_PACKAGE_FFMPEG
        default n
        help
		Build Motion using libavcodec and libavformat from the
		FFmpeg package.
```

## make/setpwc/Config.in
```kconfig
config FREETZ_PACKAGE_SETPWC
	bool "setpwc - control various features of Philips USB webcams"
	default n
	help
		With setpwc you can set and list various settings of
		Philips (and compatibles) WebCams with the 'PWC chipset'.
```

## make/uwsgi/Config.in
```kconfig
config FREETZ_PACKAGE_UWSGI
	bool "uWSGI 0.9.5"
	depends on FREETZ_PACKAGE_PYTHON
	depends on FREETZ_LIB_libpython
	default n
	help
		uWSGI is a fast (pure C), self-healing,
		developer-friendly WSGI server, aimed for
		professional python webapps deployment
		and development.
```
